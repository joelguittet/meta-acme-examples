## meta-acme-example-wifi-hotspot/conf/layer.conf
```bitbake
# We have a conf and classes directory, append to BBPATH
BBPATH .= ":${LAYERDIR}"

# We have a recipes directory, add to BBFILES
BBFILES += "${LAYERDIR}/recipes*/*/*.bb ${LAYERDIR}/recipes*/*/*.bbappend"

BBFILE_COLLECTIONS += "meta-acme-example-wifi-hotspot"
BBFILE_PATTERN_meta-acme-example-wifi-hotspot := "^${LAYERDIR}/"
BBFILE_PRIORITY_meta-acme-example-wifi-hotspot = "15"
```

## meta-acme-example-wifi/conf/layer.conf
```bitbake
# We have a conf and classes directory, append to BBPATH
BBPATH .= ":${LAYERDIR}"

# We have a recipes directory, add to BBFILES
BBFILES += "${LAYERDIR}/recipes*/*/*.bb ${LAYERDIR}/recipes*/*/*.bbappend"

BBFILE_COLLECTIONS += "meta-acme-example-wifi"
BBFILE_PATTERN_meta-acme-example-wifi := "^${LAYERDIR}/"
BBFILE_PRIORITY_meta-acme-example-wifi = "15"
```
